## meta-gyroidos-release/conf/layer.conf
```bitbake
BBPATH := "${BBPATH}:${LAYERDIR}" 

BBFILES := "${BBFILES} ${LAYERDIR}/recipes-*/*/*.bb \
           ${LAYERDIR}/recipes-*/*/*.bbappend \
	   ${LAYERDIR}/images/*.bb*"


BBFILE_COLLECTIONS += "gyroidos-release"
BBFILE_PATTERN_gyroidos-release := "^${LAYERDIR}/"
BBFILE_PRIORITY_gyroidos-release := "8"

LAYERDEPENDS_gyroidos-release = "gyroidos-layer"

LAYERSERIES_COMPAT_gyroidos-release += "kirkstone scarthgap"
```
